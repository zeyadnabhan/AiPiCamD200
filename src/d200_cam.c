/*
 * d200_cam.c - AiPi-Cam-D200 camera core (GC2145 + DVP + hardware MJPEG)
 *
 * Contains code adapted from Bouffalo Lab bouffalo_sdk (Apache License 2.0):
 *   bsp/common/image_sensor/gc2145.h, image_sensor.c,
 *   examples/peripherals/mjpeg/jpeg_head.c, mjpeg_cam_normal/main.c
 */
#include <string.h>
#include <stdint.h>
#include <stdbool.h>
#include "bflb_mtimer.h"
#include "bflb_i2c.h"
#include "bflb_cam.h"
#include "bflb_mjpeg.h"
#include "bflb_irq.h"
#include "bflb_gpio.h"
#include "bflb_l1c.h"
#include "board.h"
#include "FreeRTOS.h"
#include "task.h"
#include "d200_cam.h"

/* ------------------------------------------------------------------ */
/* GC2145 sensor, 800x600 YUV422                                       */
/* ------------------------------------------------------------------ */
struct sensor_cmd { uint16_t address; uint8_t value; };

static struct sensor_cmd gc2145_init_list[] = {
{0xfe,0xf0},{0xfe,0xf0},{0xfe,0xf0},{0xfc,0x06},{0xf6,0x00},{0xf7,0x1d},{0xf8,0x81},{0xfa,0x00},{0xf9,0xfe},{0xf2,0x00},
{0xfe,0x00},{0x03,0x04},{0x04,0xe2},{0x12,0x2e},{0x17,0x14},{0x18,0x22},{0x19,0x0e},{0x1a,0x01},{0x1b,0x4b},{0x1c,0x07},
{0x1d,0x10},{0x1e,0x88},{0x1f,0x78},{0x20,0x03},{0x21,0x40},{0x22,0xdc},{0x24,0x16},{0x25,0x01},{0x26,0x10},{0x2d,0x60},
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{0x40,0x20},{0x41,0x0f},{0xfe,0x02},{0x0f,0x05},{0xfe,0x00},{0x17,0x14},{0xfe,0x01},
};

#define GC2145_ADDR   0x3c
#define CAM_WIDTH     800
#define CAM_HEIGHT    600
#define CAM_HBLANK    0x14f
#define CAM_PCLK      48000000

/* ------------------------------------------------------------------ */
/* I2C helpers                                                         */
/* ------------------------------------------------------------------ */
static void sensor_read(struct bflb_device_s *i2c, uint8_t reg, uint8_t *val)
{
    struct bflb_i2c_msg_s msgs[2];
    msgs[0].addr = GC2145_ADDR; msgs[0].flags = I2C_M_NOSTOP; msgs[0].buffer = &reg; msgs[0].length = 1;
    msgs[1].addr = GC2145_ADDR; msgs[1].flags = I2C_M_READ;   msgs[1].buffer = val;  msgs[1].length = 1;
    bflb_i2c_transfer(i2c, msgs, 2);
}

static void sensor_write(struct bflb_device_s *i2c, uint8_t reg, uint8_t val)
{
    struct bflb_i2c_msg_s msgs[2];
    msgs[0].addr = GC2145_ADDR; msgs[0].flags = I2C_M_NOSTOP; msgs[0].buffer = &reg; msgs[0].length = 1;
    msgs[1].addr = GC2145_ADDR; msgs[1].flags = 0;            msgs[1].buffer = &val; msgs[1].length = 1;
    bflb_i2c_transfer(i2c, msgs, 2);
}

uint8_t d200_id0 = 0xEE, d200_id1 = 0xEE;

static int sensor_init(struct bflb_device_s *i2c)
{
    uint32_t i;
    bflb_i2c_init(i2c, 100000);
    sensor_read(i2c, 0xf0, &d200_id0);
    sensor_read(i2c, 0xf1, &d200_id1);
    if (d200_id0 != 0x21 || d200_id1 != 0x45) return 0;
    for (i = 0; i < sizeof(gc2145_init_list) / sizeof(gc2145_init_list[0]); i++) {
        sensor_write(i2c, (uint8_t)gc2145_init_list[i].address, gc2145_init_list[i].value);
    }
    return 1;
}

/* ------------------------------------------------------------------ */
/* JPEG header                                                         */
/* ------------------------------------------------------------------ */
static const uint8_t tableQy[] = {
    16, 11, 12, 14, 12, 10, 16, 14, 13, 14, 18, 17, 16, 19, 24, 40,
    26, 24, 22, 22, 24, 49, 35, 37, 29, 40, 58, 51, 61, 60, 57, 51,
    56, 55, 64, 72, 92, 78, 64, 68, 87, 69, 55, 56, 80, 109, 81, 87,
    95, 98, 103, 104, 103, 62, 77, 113, 121, 112, 100, 120, 92, 101, 103, 99
};
static const uint8_t tableQuv[] = {
    17, 18, 18, 24, 21, 24, 47, 26, 26, 47, 99, 66, 56, 66, 99, 99,
    99, 99, 99, 99, 99, 99, 99, 99, 99, 99, 99, 99, 99, 99, 99, 99,
    99, 99, 99, 99, 99, 99, 99, 99, 99, 99, 99, 99, 99, 99, 99, 99,
    99, 99, 99, 99, 99, 99, 99, 99, 99, 99, 99, 99, 99, 99, 99, 99
};
static const uint8_t tableHuffman[] = {
    0xFF, 0xC4, 0x00, 0x1F, 0x00, 0x00, 0x01, 0x05, 0x01, 0x01, 0x01, 0x01, 0x01, 0x01, 0x00, 0x00,
    0x00, 0x00, 0x00, 0x00, 0x00, 0x00, 0x01, 0x02, 0x03, 0x04, 0x05, 0x06, 0x07, 0x08, 0x09, 0x0A,
    0x0B,
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    0xF4, 0xF5, 0xF6, 0xF7, 0xF8, 0xF9, 0xFA
};

static void QCalc(const uint8_t *in, uint8_t *out, uint8_t q)
{
    float tq, result;
    int i;
    if (q < 1) tq = 5000.0f;
    else if (q <= 50) tq = 5000.0f / q;
    else if (q <= 100) tq = 200.0f - 2.0f * q;
    else tq = 0.0f;
    tq = tq / 100.0f;
    for (i = 0; i < 64; i++) {
        result = in[i] * tq;
        if (result > 255.0f) out[i] = 255;
        else if (result < 1.0f) out[i] = 1;
        else out[i] = (uint8_t)(result + 0.5f);
    }
}

static uint32_t jpeg_head_422(uint8_t q, int width, int height, uint8_t *out)
{
    uint32_t index = 0, i;
    static const uint8_t sof_tail[] = { 0x03, 0x01, 0x21, 0x00, 0x02, 0x11, 0x01, 0x03, 0x11, 0x01 };
    static const uint8_t sos[] = { 0xFF, 0xDA, 0x00, 0x0C, 0x03, 0x01, 0x00, 0x02, 0x11, 0x03, 0x11, 0x00, 0x3F, 0x00 };
    out[index++] = 0xFF; out[index++] = 0xD8;
    out[index++] = 0xFF; out[index++] = 0xDB; out[index++] = 0x00; out[index++] = 0x43; out[index++] = 0x00;
    QCalc(tableQy, out + index, q); index += 64;
    out[index++] = 0xFF; out[index++] = 0xDB; out[index++] = 0x00; out[index++] = 0x43; out[index++] = 0x01;
    QCalc(tableQuv, out + index, q); index += 64;
    out[index++] = 0xFF; out[index++] = 0xC0; out[index++] = 0x00; out[index++] = 0x11; out[index++] = 0x08;
    out[index++] = (uint8_t)((height >> 8) & 0xFF); out[index++] = (uint8_t)(height & 0xFF);
    out[index++] = (uint8_t)((width >> 8) & 0xFF);  out[index++] = (uint8_t)(width & 0xFF);
    for (i = 0; i < sizeof(sof_tail); i++) out[index++] = sof_tail[i];
    for (i = 0; i < sizeof(tableHuffman); i++) out[index++] = tableHuffman[i];
    for (i = 0; i < sizeof(sos); i++) out[index++] = sos[i];
    return index;
}

/* ------------------------------------------------------------------ */
/* DVP camera + MJPEG                                                  */
/* ------------------------------------------------------------------ */
#define ROW_NUM     (8 * 2)
#define FRAME_MAX   (64 * 1024)
#define HW_FRAMES   3

static __attribute__((aligned(32))) ATTR_NOINIT_PSRAM_SECTION uint8_t dvp_buffer[CAM_WIDTH * 2 * ROW_NUM];
static __attribute__((aligned(32))) ATTR_NOINIT_PSRAM_SECTION uint8_t mjpeg_buffer[FRAME_MAX * HW_FRAMES];
/* frame buffers: ISR fills a free one, readers hold others, one is the newest */
#define NUM_BUF 4
static __attribute__((aligned(32))) ATTR_NOINIT_PSRAM_SECTION uint8_t frame_buf[NUM_BUF][FRAME_MAX];

static struct bflb_device_s *i2c0;
static struct bflb_device_s *cam0;
static struct bflb_device_s *mjpeg;
static int cam_ok = 0;

static volatile uint32_t frame_len[NUM_BUF];
static volatile uint8_t readers[NUM_BUF];   /* how many clients are sending this buffer */
static volatile int latest = -1;
static volatile uint32_t frame_seq = 0;
static uint8_t jpg_head_buf[800];

static void mjpeg_isr(int irq, void *arg)
{
    uint8_t *pic;
    uint32_t len;
    uint32_t st = bflb_mjpeg_get_intstatus(mjpeg);

    if (st & MJPEG_INTSTS_ONE_FRAME) {
        bflb_mjpeg_int_clear(mjpeg, MJPEG_INTCLR_ONE_FRAME);
        len = bflb_mjpeg_get_frame_info(mjpeg, &pic);
        if (len > 0 && len <= FRAME_MAX &&
            (uint32_t)pic >= (uint32_t)mjpeg_buffer &&
            ((uint32_t)pic + len) <= ((uint32_t)mjpeg_buffer + sizeof(mjpeg_buffer))) {
            int w;
            for (w = 0; w < NUM_BUF; w++) {
                if (w != latest && readers[w] == 0) break;
            }
            if (w < NUM_BUF) {            /* else: all busy, drop this frame */
                bflb_l1c_dcache_invalidate_range(pic, len);
                memcpy(frame_buf[w], pic, len);
                frame_len[w] = len;
                latest = w;
                frame_seq++;
            }
        }
        bflb_mjpeg_pop_one_frame(mjpeg);
    }
    if (st & (1 << 6)) {
        bflb_mjpeg_int_clear(mjpeg, 1 << 10); /* frame too big: dropped */
    }
}

int d200_cam_begin(uint8_t quality)
{
    struct bflb_cam_config_s cam_config;
    struct bflb_mjpeg_config_s config;
    struct bflb_device_s *gpio;
    uint32_t head_len;

    if (cam_ok) return 0;

    /* D200: camera 3.3V is switched by Q1, GPIO19 LOW = power on */
    gpio = bflb_device_get_by_name("gpio");
    bflb_gpio_init(gpio, GPIO_PIN_19, GPIO_OUTPUT | GPIO_PULLUP | GPIO_SMT_EN | GPIO_DRV_1);
    bflb_gpio_reset(gpio, GPIO_PIN_19);
    bflb_mtimer_delay_ms(100);

    board_dvp_gpio_init(); /* I2C0, MCLK, DVP data pins, sensor reset */
    bflb_mtimer_delay_ms(50);

    i2c0 = bflb_device_get_by_name("i2c0");
    cam0 = bflb_device_get_by_name("cam0");
    mjpeg = bflb_device_get_by_name("mjpeg");

    if (!sensor_init(i2c0)) return -1;

    memset(&cam_config, 0, sizeof(cam_config));
    cam_config.input_format = 0; /* YUV422 YUYV */
    cam_config.resolution_x = CAM_WIDTH;
    cam_config.resolution_y = CAM_HEIGHT;
    cam_config.h_blank = CAM_HBLANK;
    cam_config.pixel_clock = CAM_PCLK;
    cam_config.with_mjpeg = true;
    cam_config.input_source = CAM_INPUT_SOURCE_DVP;
    cam_config.output_format = CAM_OUTPUT_FORMAT_AUTO;
    cam_config.output_bufaddr = (uint32_t)dvp_buffer;
    cam_config.output_bufsize = CAM_WIDTH * 2 * ROW_NUM;
    bflb_cam_init(cam0, &cam_config);
    bflb_cam_start(cam0);

    config.format = MJPEG_FORMAT_YUV422_YUYV;
    config.quality = quality;
    config.rows = ROW_NUM;
    config.resolution_x = CAM_WIDTH;
    config.resolution_y = CAM_HEIGHT;
    config.input_bufaddr0 = (uint32_t)dvp_buffer;
    config.input_bufaddr1 = 0;
    config.output_bufaddr = (uint32_t)mjpeg_buffer;
    config.output_bufsize = sizeof(mjpeg_buffer);
    config.input_yy_table = NULL;
    config.input_uv_table = NULL;
    bflb_mjpeg_init(mjpeg, &config);

    head_len = jpeg_head_422(quality, CAM_WIDTH, CAM_HEIGHT, jpg_head_buf);
    bflb_mjpeg_fill_jpeg_header_tail(mjpeg, jpg_head_buf, head_len);

    bflb_mjpeg_tcint_mask(mjpeg, false);
    bflb_irq_attach(mjpeg->irq_num, mjpeg_isr, NULL);
    bflb_irq_enable(mjpeg->irq_num);
    bflb_mjpeg_start(mjpeg);

    cam_ok = 1;
    return 0;
}

const char *d200_cam_sensor_name(void) { return cam_ok ? "GC2145" : "none"; }
uint16_t d200_cam_width(void) { return CAM_WIDTH; }
uint16_t d200_cam_height(void) { return CAM_HEIGHT; }
uint32_t d200_cam_frame_count(void) { return frame_seq; }
uint16_t d200_cam_sensor_id(void) { return ((uint16_t)d200_id0 << 8) | d200_id1; }

int d200_cam_lock(const uint8_t **buf, uint32_t *len, uint32_t *seq, uint32_t timeout_ms)
{
    uint64_t start = bflb_mtimer_get_time_ms();
    if (!cam_ok) return 0;
    while (1) {
        /* critical section: no other task (and not the camera ISR) can run in between,
           so the reader count always lands on the buffer that is handed out */
        taskENTER_CRITICAL();
        bflb_irq_disable(mjpeg->irq_num);
        int L = latest;
        if (L >= 0 && frame_seq != *seq) {
            readers[L]++;
            *seq = frame_seq;
            *buf = frame_buf[L];
            *len = frame_len[L];
            bflb_irq_enable(mjpeg->irq_num);
            taskEXIT_CRITICAL();
            return 1;
        }
        bflb_irq_enable(mjpeg->irq_num);
        taskEXIT_CRITICAL();
        if ((bflb_mtimer_get_time_ms() - start) >= timeout_ms) return 0;
        vTaskDelay(pdMS_TO_TICKS(5));
    }
}

void d200_cam_unlock(const uint8_t *buf)
{
    int i;
    taskENTER_CRITICAL();
    bflb_irq_disable(mjpeg->irq_num);
    for (i = 0; i < NUM_BUF; i++) {
        if (buf == frame_buf[i] && readers[i] > 0) readers[i]--;
    }
    bflb_irq_enable(mjpeg->irq_num);
    taskEXIT_CRITICAL();
}
